/*
 * nokia5110.c
 *
 *  Created on: 7 sept. 2017
 *      Author: ManoloP
 */

#include <mapesynth.h>
#include <msp430.h>
#include "nokia5110.h"



void init_hw(void){
/*WDTCTL = WDTPW + WDTHOLD; // disable WDT
BCSCTL1 = CALBC1_1MHZ; // 1MHz clock
DCOCTL = CALDCO_1MHZ;*/
//
//P3OUT |= LCD5110_SCE_PIN + LCD5110_DC_PIN;
//P3OUT &= LCD5110_SCLK_PIN;
//P3DIR |= LCD5110_SCE_PIN + LCD5110_DC_PIN+LCD5110_SCLK_PIN + LCD5110_DN_PIN;

/***************
 * SPI NOKIA: MSB, CLK en reposo a 0, lee en flanco de subida:
 * Poner CS, poner bit, poner CLK, quitar CLK poniendo siguiente bit, repetir...
 *
 **************/

}


void initLCD() {
writeToLCD(LCD5110_COMMAND, PCD8544_FUNCTIONSET | PCD8544_EXTENDEDINSTRUCTION);
writeToLCD(LCD5110_COMMAND, PCD8544_SETVOP | 0x3F);
writeToLCD(LCD5110_COMMAND, PCD8544_SETTEMP | 0x02);
writeToLCD(LCD5110_COMMAND, PCD8544_SETBIAS | 0x03);
writeToLCD(LCD5110_COMMAND, PCD8544_FUNCTIONSET);
writeToLCD(LCD5110_COMMAND, PCD8544_DISPLAYCONTROL | PCD8544_DISPLAYNORMAL);
}


void writeToLCD(unsigned char dataCommand, unsigned char data)
{
    unsigned char i;
    LCD5110_SELECT;
    if(dataCommand)
    {
        LCD5110_SET_DATA;
    }
    else
    {
        LCD5110_SET_COMMAND;
    }

    if(data&0x80)
    {
        P3OUT |= LCD5110_DN_PIN;
    }
    else
    {
        P3OUT &=~LCD5110_DN_PIN;

    }
    for(i=0x40;i;i=i>>1)
    {
        P3OUT |= LCD5110_SCLK_PIN;  //Flanco de subida de reloj

        if(data&i)
        {
            P3OUT |= LCD5110_DN_PIN; //Si dato ==1: pongo D=1, CLK=0
            P3OUT &=~LCD5110_SCLK_PIN;

        }
        else
        {
            P3OUT &=~(LCD5110_DN_PIN+LCD5110_SCLK_PIN); //si no, pongo D=0, CLK=0
        }
    }
    P3OUT |= LCD5110_SCLK_PIN;  //Flanco de subida de reloj
    P3OUT &=~LCD5110_SCLK_PIN;  // Ultimo flanco de bajada
    LCD5110_DESELECT;
}


void writeStringToLCD(const char *string) {
while(*string) {
writeCharToLCD(*string++);
}
}

void writeCharToLCD(char c) {
unsigned char i;
for(i = 0; i < 5; i++) {
writeToLCD(LCD5110_DATA, font[c - 0x20][i]);
}
writeToLCD(LCD5110_DATA, 0);
}

void writeBlockToLCD(char *byte, unsigned int length) {
unsigned int c = 0;
while(c < length) {
writeToLCD(LCD5110_DATA, *byte++);
c++;
}
}

void writeGraphicToLCD(char *byte, unsigned char transform) {
int c = 0;
char block[8];

if(transform & FLIP_V) {
SPI_LSB_FIRST;
}
if(transform & ROTATE) {
c = 1;
while(c != 0) {
(*byte & 0x01) ? (block[7] |= c) : (block[7] &= ~c);
(*byte & 0x02) ? (block[6] |= c) : (block[6] &= ~c);
(*byte & 0x04) ? (block[5] |= c) : (block[5] &= ~c);
(*byte & 0x08) ? (block[4] |= c) : (block[4] &= ~c);
(*byte & 0x10) ? (block[3] |= c) : (block[3] &= ~c);
(*byte & 0x20) ? (block[2] |= c) : (block[2] &= ~c);
(*byte & 0x40) ? (block[1] |= c) : (block[1] &= ~c);
(*byte & 0x80) ? (block[0] |= c) : (block[0] &= ~c);
*byte++;
c <<= 1;
}
} else {
while(c < 8) {
block[c++] = *byte++;
}
}

if(transform & FLIP_H) {
c = 7;
while(c > -1) {
writeToLCD(LCD5110_DATA, block[c--]);
}
} else {
c = 0;
while(c < 8) {
writeToLCD(LCD5110_DATA, block[c++]);
}
}
SPI_MSB_FIRST;
}

void clearLCD() {
    int c = 0;
setAddr(0, 0);

while(c < PCD8544_MAXBYTES) {
writeToLCD(LCD5110_DATA, 0);
c++;
}
setAddr(0, 0);
}

void clearBank(unsigned char bank) {
    int c = 0;

    setAddr(0, bank);
while(c < PCD8544_HPIXELS) {
writeToLCD(LCD5110_DATA, 0);
c++;
}
setAddr(0, bank);
}

void setAddr(unsigned char xAddr, unsigned char yAddr) {
writeToLCD(LCD5110_COMMAND, PCD8544_SETXADDR | xAddr);
writeToLCD(LCD5110_COMMAND, PCD8544_SETYADDR | yAddr);
}

void setChAddr(unsigned char xAddr, unsigned char yAddr) {
    if(xAddr<14){ xAddr=xAddr*6;} else {xAddr=0;}
        writeToLCD(LCD5110_COMMAND, PCD8544_SETYADDR | yAddr);

        writeToLCD(LCD5110_COMMAND, PCD8544_SETXADDR |xAddr);

}

void escribe(char col, char lin, char *cadena)
{
    setAddr(col, lin);
    writeStringToLCD(cadena);
}



const unsigned char Logotipo [] = {
0x00, 0x00, 0x00, 0x00, 0x00, 0x00, 0x00, 0x00, 0x00, 0x00, 0x00, 0x80, 0xc0, 0xe0, 0xe0, 0xe0,
0xe0, 0xe0, 0xe0, 0xe0, 0xe0, 0xe0, 0xc0, 0x80, 0x00, 0x00, 0x00, 0x00, 0x00, 0x00, 0x00, 0x00,
0x80, 0x80, 0xc0, 0xc0, 0xe0, 0xe0, 0x60, 0xe0, 0xe0, 0xe0, 0xe0, 0x00, 0x00, 0xe0, 0xe0, 0xe0,
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0x00, 0x07, 0x07, 0x07, 0x07, 0x00, 0x00, 0x00};

